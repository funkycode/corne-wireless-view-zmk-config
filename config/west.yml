## config/west.yml
```yaml
manifest:
  remotes:
    - name: zmkfirmware
      url-base: https://github.com/zmkfirmware
    - name: badjeff
      url-base: https://github.com/badjeff
  projects:
    - name: zmk
      remote: zmkfirmware
      revision: main
      import: app/west.yml
    - name: zmk-pmw3610-driver
      remote: badjeff
      revision: main
    - name: zmk-analog-input-driver
      remote: badjeff
      revision: main
    - name: zmk-behavior-insomnia
      remote: badjeff
      revision: main
    - name: zmk-behavior-key-press-lip
      remote: badjeff
      revision: main
    - name: zmk-behavior-key-tempo
      remote: badjeff
      revision: main
    - name: zmk-behavior-mouse-key-toggle
      remote: badjeff
      revision: main
    - name: zmk-output-behavior-listener
      remote: badjeff
      revision: main
    - name: zmk-split-peripheral-bonding-tweak
      remote: badjeff
      revision: main
    - name: zmk-kscan-blackout
      remote: badjeff
      revision: main
    - name: zmk-input-processor-mixer
      remote: badjeff
      revision: main
    - name: zmk-input-processor-report-rate-limit
      remote: badjeff
      revision: main
    - name: zmk-input-processor-xyz
      remote: badjeff
      revision: main
    - name: kb_zmk_ps2_mouse_trackpoint_driver
      remote: badjeff
      revision: main
  self:
    path: config
```
