#include <input/processors/report_rate_limit.dtsi>
#include <input/processors/xyz.dtsi>

#include "corne_trackball.dtsi"
/{
  split_inputs {
    #address-cells = <1>;
    #size-cells = <0>;

    trackball_split: trackball@1 { compatible = "zmk,input-split"; reg = <1>; };
  };
};
&trackball_split { status = "disabled"; };
&trackball_split { device = <&trackball>; input-processors = <&zip_report_rate_limit 4>, <&zip_xyz>; };

